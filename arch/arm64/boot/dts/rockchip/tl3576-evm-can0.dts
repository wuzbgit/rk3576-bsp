/*
 * Copyright (C) 2015 GuangZhou Tronlong co., LTD - http://www.tronlong.com
 *
 * This program is free software; you can redistribute it and/or modify
 * it under the terms of the GNU General Public License version 2 as
 * published by the Free Software Foundation.
 */

/dts-v1/;

#include "tl3576-evm.dts"

/ {
        model = "TL3576-EVM-CAN";
};

&can0 {
	status = "okay";
};

&i2c4 {
	status = "disabled";
};



